/*****************************************************************************************/

// Code imported from https://github.com/someone42/hardware-bitcoin-wallet/blob/master/
// 12.04.2014
/*
   Copyright (c) 2011-2012 someone42 All rights reserved.

   Redistribution and use in source and binary forms, with or without modification, are permitted provided that the following conditions are met:

   Redistributions of source code must retain the above copyright notice, this list of conditions and the following disclaimer.

   Redistributions in binary form must reproduce the above copyright notice, this list of conditions and the following disclaimer in the
   documentation and/or other materials provided with the distribution.

   THIS SOFTWARE IS PROVIDED BY THE COPYRIGHT HOLDERS AND CONTRIBUTORS "AS IS" AND ANY EXPRESS OR IMPLIED WARRANTIES, INCLUDING, BUT NOT LIMITED TO,
   THE IMPLIED WARRANTIES OF MERCHANTABILITY AND FITNESS FOR A PARTICULAR PURPOSE ARE DISCLAIMED. IN NO EVENT SHALL THE COPYRIGHT HOLDER OR
   CONTRIBUTORS BE LIABLE FOR ANY DIRECT, INDIRECT, INCIDENTAL, SPECIAL, EXEMPLARY, OR CONSEQUENTIAL DAMAGES (INCLUDING, BUT NOT LIMITED TO,
   PROCUREMENT OF SUBSTITUTE GOODS OR SERVICES; LOSS OF USE, DATA, OR PROFITS; OR BUSINESS INTERRUPTION) HOWEVER CAUSED AND ON ANY THEORY OF
   LIABILITY, WHETHER IN CONTRACT, STRICT LIABILITY, OR TORT (INCLUDING NEGLIGENCE OR OTHERWISE) ARISING IN ANY WAY OUT OF THE USE OF THIS SOFTWARE,
   EVEN IF ADVISED OF THE POSSIBILITY OF SUCH DAMAGE.

 */


/** PBKDF2 is used to derive encryption keys. In order to make brute-force
* attacks more expensive, this should return a number which is as large
* as possible, without being so large that key derivation requires an
* excessive amount of time (> 1 s). This is a platform-dependent function
* because key derivation speed is platform-dependent.
*
* In order to permit key recovery when the number of iterations is unknown,
* this should be a power of 2. That way, an implementation can use
* successively greater powers of 2 until the correct number of iterations is
* found.
* \return Number of iterations to use in PBKDF2 algorithm.
*/

#include <string.h>

#include "stm32f10x.h"
#include "pbkdf2.h"
#include "sha4.h"

#define SHA512_HASH_LENGTH                        64    // 64 Byte

uint32_t getPBKDF2Iterations (void)
{
#ifdef TEST_PBKDF2
    return 1024;
#else
    return (256);   // for local CPU speed (ca. 0,6 sec)
#endif
}

/** Write 32 bit unsigned integer into a byte array in big-endian format.
* \param out The destination byte array. This must have space for at
* least 4 bytes.
* \param in The source integer.
*/
void writeU32BigEndian (uint8_t * out, uint32_t in)
{
    out[0] = (uint8_t) (in >> 24);
    out[1] = (uint8_t) (in >> 16);
    out[2] = (uint8_t) (in >> 8);
    out[3] = (uint8_t) in;
}



void pbkdf2 (uint8_t *out, const uint8_t *password, const uint32_t password_length, const uint8_t *salt, const uint32_t salt_length)
{
    uint8_t u[SHA512_HASH_LENGTH];
    uint8_t hmac_result[SHA512_HASH_LENGTH];
    uint32_t u_length;
    uint32_t num_iterations;
    uint32_t i;
    uint32_t j;

    memset (out, 0, SHA512_HASH_LENGTH);
    memset (u, 0, sizeof (u));

    if (salt_length > (SHA512_HASH_LENGTH - 4))
    {
        // Salt too long.
        //CI_LocalPrintf ("Salt too long\r\n");
        return;
    }
    else
    {
        u_length = salt_length;
    }

    memcpy (u, salt, u_length);

    writeU32BigEndian (&(u[u_length]), 1);

    u_length += 4;

    num_iterations = getPBKDF2Iterations ();

    for (i = 0; i < num_iterations; i++)
    {

        sha4_hmac ((unsigned char*)password, password_length, u, u_length, hmac_result, FALSE);

        memcpy (u, hmac_result, sizeof (u));

        u_length = SHA512_HASH_LENGTH;

        for (j = 0; j < SHA512_HASH_LENGTH; j++)
        {
            out[j] ^= u[j];
        }
    }
}



#ifdef TEST_PBKDF2

/** Stores one test vector for pbkdf2(). */
struct PBKDF2TestVector
{
    const char* password;
    unsigned long password_length;
    const char* salt;
    unsigned long salt_length;
    const uint8_t expected_result[SHA512_HASH_LENGTH];
};

/** Test vectors for pbkdf2().
* It's hard to find publicly available test vectors for PBKDF2-HMAC-SHA512
* (though there are lots for PBKDF2-HMAC-SHA1), so these were generated
* using Python 2.5.2 with pycrypto v2.6. Here's the source:
\code

from Crypto.Hash import SHA512, HMAC
from Crypto.Protocol.KDF import PBKDF2
import sys

p = "1" # Set to password
s = "2" # Set to salt

f = lambda key, msg: HMAC.new(key, msg, SHA512).digest()
out = PBKDF2(password=p, salt=s, dkLen=64, count=1024, prf=f)
str = out.encode("hex")

first = True
while len(str) > 0:
if not first:
sys.stdout.write(", ")
first = False
if len(str) % 16 == 0:
sys.stdout.write("\n")
sys.stdout.write("0x" + str[0:2])
str = str[2:]

\endcode
* \showinitializer
*/
struct PBKDF2TestVector pbkdf2_test_vectors[] = {

    {"1", 1,
     "2", 1,
     {0xa1, 0x80, 0x45, 0x1f, 0x46, 0x18, 0xdf, 0x95,
      0x15, 0xab, 0x0b, 0xe2, 0xc5, 0x6a, 0xc3, 0x42,
      0x02, 0x87, 0xcb, 0x8f, 0xc0, 0x15, 0xf7, 0x84,
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      0xc6, 0xed, 0x63, 0x9f, 0x35, 0xbb, 0x12, 0xe8}},

    {"", 0,
     "", 0,
     {0xfb, 0xaa, 0x2a, 0xcb, 0x43, 0xd1, 0xe1, 0xaf,
      0xff, 0x85, 0x83, 0x58, 0xaf, 0x28, 0x43, 0xcc,
      0x57, 0x8d, 0xb4, 0xe2, 0x2b, 0x94, 0x21, 0x18,
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      0xee, 0x96, 0x81, 0x04, 0xcc, 0x1b, 0x51, 0xa4}},

    {"Bitcoin uses peer to peer technology to operate with no central authority", 73,
     "Common salt has the chemical formula NaCl", 41,
     {0x34, 0x5c, 0x92, 0xb1, 0xaa, 0xf0, 0xc1, 0x9e,
      0xfd, 0x22, 0xfd, 0x80, 0x6d, 0x27, 0x35, 0x87,
      0xdc, 0xe8, 0x9c, 0xfa, 0xe6, 0xdc, 0x02, 0x50,
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      0xf5, 0x37, 0xe7, 0xe6, 0x39, 0x83, 0x80, 0x37}},

    {"Bitcoin uses peer to peer technology to operate with no central authority", 73,
     "", 0,
     {0x5d, 0x8f, 0x77, 0x0f, 0xc9, 0xa7, 0x8c, 0x9f,
      0x7d, 0x3d, 0xde, 0x84, 0x49, 0xe0, 0x66, 0xca,
      0x3d, 0x62, 0x27, 0x97, 0x9f, 0x21, 0x8e, 0x18,
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      0x47, 0xcd, 0x39, 0xd3, 0x1b, 0x67, 0x42, 0x1d}},

    {"", 0,
     "Common salt has the chemical formula NaCl", 41,
     {0x12, 0x77, 0x94, 0xe0, 0x0d, 0xd3, 0x10, 0xcc,
      0xdb, 0x58, 0xc3, 0xc0, 0x35, 0x92, 0xe4, 0x0d,
      0x54, 0xc4, 0x10, 0xaf, 0x49, 0x98, 0x39, 0xee,
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      0x7a, 0x72, 0x74, 0x7c, 0xb0, 0x43, 0xd5, 0x7a}},

    {"Pass\0word", 9,
     "Sa\0lt", 5,
     {0xaa, 0x55, 0xb0, 0x5f, 0x2c, 0x77, 0x11, 0xbb,
      0x83, 0xea, 0x01, 0xe5, 0x62, 0xc2, 0x5c, 0x8d,
      0x9f, 0xc1, 0xdc, 0xb2, 0xc5, 0xac, 0x7a, 0x36,
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      0x75, 0xfc, 0xe4, 0x7a, 0x8b, 0xc2, 0xa0, 0xf5}},

    {"\x00\x01\xff\xfe", 4,
     "\x00\x01\xff\xfe", 4,
     {0x58, 0xee, 0x8a, 0xe3, 0x70, 0xc4, 0xed, 0x62,
      0x88, 0xf0, 0x48, 0x50, 0xf7, 0x22, 0x6e, 0xe1,
      0x82, 0xf3, 0x69, 0xaa, 0xdc, 0xf1, 0x1e, 0x6b,
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      0xad, 0x6a, 0x15, 0xe6, 0xff, 0x56, 0xe7, 0xdf}},

    {"Test vector", 11,
     "This is a maximum length salt ..ABCDEFGH[][][][][][][]\\\\!!!!", 60,
     {0xe0, 0xc1, 0x06, 0x48, 0xfc, 0x64, 0xa9, 0x3a,
      0xd1, 0xc8, 0x35, 0x1a, 0x2c, 0x03, 0x6b, 0xc6,
      0x16, 0xf5, 0x75, 0x96, 0xc1, 0x34, 0x5d, 0x73,
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      0xd6, 0xbb, 0xdb, 0x1c, 0x03, 0x52, 0x0c, 0x43}},
    /* Don't work, password length not necessary (memory size problem ?) {"LongCatIsLongLongCatIsLongLongCatIsLongLongCatIsLongLongCatIsLong\
       LongCatIsLongLongCatIsLongLongCatIsLongLongCatIsLongLongCatIsLong\ LongCatIsLongLongCatIsLongLongCatIsLongLongCatIsLongLongCatIsLong\
       LongCatIsLongLongCatIsLongLongCatIsLongLongCatIsLongLongCatIsLong\ LongCatIsLongLongCatIsLongLongCatIsLongLongCatIsLongLongCatIsLong\
       LongCatIsLongLongCatIsLongLongCatIsLongLongCatIsLongLongCatIsLong\ LongCatIsLongLongCatIsLongLongCatIsLongLongCatIsLongLongCatIsLong\
       LongCatIsLongLongCatIsLongLongCatIsLongLongCatIsLongLongCatIsLong\ LongCatIsLongLongCatIsLong", 546, "salt", 4, {0x46, 0xdd, 0x09, 0xe7, 0x17,
       0x2a, 0xf3, 0x93, 0x6f, 0x36, 0xb5, 0x5a, 0xcc, 0x51, 0xc8, 0x09, 0xf6, 0xcc, 0xd3, 0x1e, 0x8e, 0x53, 0x17, 0xea, 0xa7, 0x9c, 0xab, 0xab,
       0x28, 0xc7, 0xe6, 0x16, 0x9f, 0xa9, 0x56, 0x0a, 0xc9, 0x4b, 0x53, 0x20, 0x1f, 0xbc, 0x06, 0x04, 0xd6, 0xa5, 0xf0, 0xc2, 0x39, 0x4f, 0xee,
       0xa9, 0x91, 0x73, 0x61, 0xd7, 0xf5, 0xb6, 0x3a, 0xdb, 0x30, 0x0f, 0xdc, 0x85}} */
};

void pbkdf2_test (void)
{
    uint32_t num_test_vectors;
    uint32_t i;
    uint8_t out[SHA512_HASH_LENGTH];

    // initTests(__FILE__);

    num_test_vectors = sizeof (pbkdf2_test_vectors) / sizeof (struct PBKDF2TestVector);

    // num_test_vectors = 1;

    for (i = 0; i < num_test_vectors; i++)
    {
       // CI_LocalPrintf ("Test %d - PW len %3d - Salt len %3d - ", i, pbkdf2_test_vectors[i].password_length, pbkdf2_test_vectors[i].salt_length);

        pbkdf2 (out,
                (const uint8_t *) pbkdf2_test_vectors[i].password,
                pbkdf2_test_vectors[i].password_length, (const uint8_t *) pbkdf2_test_vectors[i].salt, pbkdf2_test_vectors[i].salt_length);


        if (memcmp (out, pbkdf2_test_vectors[i].expected_result, SHA512_HASH_LENGTH))
        {
            // ("fail, got:\n");
            HexPrint (SHA512_HASH_LENGTH, out);
            //CI_LocalPrintf ("\r\n");

            //CI_LocalPrintf ("\nExpected:\n");
            HexPrint (SHA512_HASH_LENGTH, pbkdf2_test_vectors[i].expected_result);
            //CI_LocalPrintf ("\r\n");
        }
        else
        {
            //CI_LocalPrintf ("Test %d ok\r\n", i);
        }
    }

    // finishTests();
}

#endif // #ifdef TEST_PBKDF2